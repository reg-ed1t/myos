ENTRY(_start)

SECTIONS
{
    . = 1M;

    __kernel_start = .;

    .multiboot : {
        KEEP(*(.multiboot))
    }

    .text : {
        *(.text)
    }

    .rodata : {
        *(.rodata)
    }

    .data : {
        *(.data)
    }

    .bss : {
        *(.bss)
    }

    __kernel_end = .;
}